## main/Kconfig.projbuild
```kconfig
menu "Example Configuration"

    config ESP_WIFI_SSID
        string "WiFi SSID"
        default "myssid"
        help
            SSID (network name) for the example to connect to.

    config ESP_WIFI_PASSWORD
        string "WiFi Password"
        default "mypassword"
        help
            WiFi password (WPA or WPA2) for the example to use.

    config ESP_MAX_STA_CONN
        int "Maximal STA connections"
        default 4
        help
            Max number of the STA connects to AP.

    config ESP_HTTP_SERVER_ADDR
        string "Http server url"
        default "api.tago.io"
        help
            HTTP server url to connect

    config ESP_DEVICE_TOKEN
        string "Device Token for HTTP server authentication"
        default "xxxxxxxx-xxxx-xxxx-xxxx-xxxxxxxxxxxx"
        help
            Device Token to authenticate the conection to the http server
endmenu
```
